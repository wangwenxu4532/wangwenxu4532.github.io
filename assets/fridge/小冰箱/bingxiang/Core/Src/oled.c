/**
 * OLED SSD1306 驱动 (软件I2C, 128x64)
 * PB6=SCL, PB7=SDA
 * SCL: 推挽输出 (主机始终控制时钟)
 * SDA: 输出PP只驱低电平; 释放高电平时切输入+上拉
 *       永远不会和从机打架, 无需外部上拉电阻
 */

#include "oled.h"
#include <string.h>
#include <stdio.h>

/* ---- 引脚 ---- */
#define SCL_PIN   GPIO_PIN_6
#define SDA_PIN   GPIO_PIN_7
#define OLED_PORT GPIOB

/* 128x64 全屏缓冲区 */
static uint8_t OLED_Buffer[OLED_WIDTH * OLED_HEIGHT / 8];

/* I2C 地址: 初始化时自动探测 */
static uint8_t oled_addr = (0x3C << 1);

/* ---- 5x7 字库 (ASCII 32~127) ---- */
static const uint8_t Font5x7[][5] = {
    {0x00,0x00,0x00,0x00,0x00}, /* ' ' */
    {0x00,0x00,0x5F,0x00,0x00}, /* ! */
    {0x00,0x07,0x00,0x07,0x00}, /* " */
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    {0x08,0x08,0x2A,0x1C,0x08}, /* ~ */
};

/* ================================================================
 *  软件 I2C (安全版)
 *
 *  策略:
 *    SCL → 始终推挽输出 (SSD1306 不做时钟拉伸)
 *    SDA → 输出PP只驱低电平; 高电平由输入+内部上拉产生
 *          这样永远不会和从机的 ACK 驱动冲突
 *
 *  时序 (每个延时 ~10μs, SCL ≈ 30kHz, 留有充裕裕量)
 * ================================================================ */

static void delay_us(uint32_t us)
{
    uint32_t cnt = us * (SystemCoreClock / 1000000);
    while (cnt--) {
        __NOP();
    }
}

/* SDA 模式切换 (直接操作寄存器) */
static void sda_out(void)
{
    uint32_t crl = OLED_PORT->CRL;
    crl &= ~(0xFUL << 28);
    crl |=  (0x3UL << 28);  /* PB7: CNF=00 MODE=11 → 推挽输出 50MHz */
    OLED_PORT->CRL = crl;
}

static void sda_in(void)
{
    uint32_t crl = OLED_PORT->CRL;
    crl &= ~(0xFUL << 28);
    crl |=  (0x8UL << 28);  /* PB7: CNF=10 MODE=00 → 输入 */
    OLED_PORT->CRL = crl;
    OLED_PORT->ODR |= SDA_PIN;  /* 上拉 */
}

/* 引脚控制 */
#define SCL_H()  (OLED_PORT->BSRR = SCL_PIN)
#define SCL_L()  (OLED_PORT->BRR  = SCL_PIN)
#define SDA_L()  do { sda_out(); OLED_PORT->BRR = SDA_PIN; } while(0)
#define SDA_H()  sda_in()   /* 释放总线 → 输入+上拉拉高 */
#define SDA_RD() ((OLED_PORT->IDR & SDA_PIN) ? 1 : 0)

/* ---- 初始化 ---- */
static void i2c_init(void)
{
    __HAL_RCC_GPIOB_CLK_ENABLE();

    __HAL_RCC_I2C1_CLK_DISABLE();
    I2C1->CR1 = 0x0000;
    I2C1->CR2 = 0x0000;

    GPIO_InitTypeDef g = {0};
    g.Pin   = SCL_PIN;
    g.Mode  = GPIO_MODE_OUTPUT_PP;
    g.Pull  = GPIO_NOPULL;
    g.Speed = GPIO_SPEED_FREQ_HIGH;
    HAL_GPIO_Init(OLED_PORT, &g);

    g.Pin   = SDA_PIN;
    g.Mode  = GPIO_MODE_INPUT;
    g.Pull  = GPIO_PULLUP;
    HAL_GPIO_Init(OLED_PORT, &g);

    SCL_H();
    delay_us(10);
}

/* ---- 起始信号 ---- */
static void i2c_start(void)
{
    SDA_L();
    delay_us(5);
    SCL_L();
    delay_us(5);
}

/* ---- 停止信号 ---- */
static void i2c_stop(void)
{
    SDA_L();
    delay_us(5);
    SCL_H();
    delay_us(5);
    SDA_H();
    delay_us(5);
}

/* ---- 写一个字节, 返回 0=ACK / 非0=NACK ---- */
static uint8_t i2c_write(uint8_t byte)
{
    for (uint8_t i = 0; i < 8; i++) {
        if (byte & 0x80) {
            SDA_H();
        } else {
            SDA_L();
        }
        delay_us(3);
        SCL_H();
        delay_us(5);
        SCL_L();
        delay_us(3);
        byte <<= 1;
    }

    SDA_H();
    delay_us(5);

    SCL_H();
    delay_us(5);
    uint8_t ack = SDA_RD();
    SCL_L();
    delay_us(3);

    return ack;
}

/* ================================================================
 *  SSD1306 命令/数据
 * ================================================================ */

static void OLED_WriteCmd(uint8_t cmd)
{
    i2c_start();
    i2c_write(oled_addr);
    i2c_write(0x00);
    i2c_write(cmd);
    i2c_stop();
}

static void OLED_WriteMultiData(const uint8_t *data, uint16_t len)
{
    i2c_start();
    i2c_write(oled_addr);
    i2c_write(0x40);
    for (uint16_t i = 0; i < len; i++) {
        i2c_write(data[i]);
    }
    i2c_stop();
}

static void OLED_SetPos(uint8_t x, uint8_t y)
{
    OLED_WriteCmd(0xB0 + y);
    OLED_WriteCmd(((x & 0xF0) >> 4) | 0x10);
    OLED_WriteCmd((x & 0x0F) | 0x00);
}

void OLED_Refresh(void)
{
    for (uint8_t page = 0; page < 8; page++) {
        OLED_SetPos(0, page);
        OLED_WriteMultiData(&OLED_Buffer[page * OLED_WIDTH], OLED_WIDTH);
    }
}

/* ---- 探测 I2C 地址 ---- */
static uint8_t i2c_probe(uint8_t addr)
{
    i2c_start();
    uint8_t ack = i2c_write(addr);
    i2c_stop();
    return (ack == 0);
}

#define ADDR_3C  (0x3C << 1)
#define ADDR_3D  (0x3D << 1)

/* ---- SSD1306 初始化序列 ---- */
static void ssd1306_init_seq(void)
{
    OLED_WriteCmd(0xAE);

    OLED_WriteCmd(0x20);
    OLED_WriteCmd(0x00);

    OLED_WriteCmd(0xB0);

    OLED_WriteCmd(0xC8);

    OLED_WriteCmd(0x00);
    OLED_WriteCmd(0x10);

    OLED_WriteCmd(0x40);

    OLED_WriteCmd(0x81);
    OLED_WriteCmd(0x7F);

    OLED_WriteCmd(0xA1);

    OLED_WriteCmd(0xA6);

    OLED_WriteCmd(0xA8);
    OLED_WriteCmd(0x3F);

    OLED_WriteCmd(0xA4);

    OLED_WriteCmd(0xD3);
    OLED_WriteCmd(0x00);

    OLED_WriteCmd(0xD5);
    OLED_WriteCmd(0xF0);

    OLED_WriteCmd(0xD9);
    OLED_WriteCmd(0x22);

    OLED_WriteCmd(0xDA);
    OLED_WriteCmd(0x12);

    OLED_WriteCmd(0xDB);
    OLED_WriteCmd(0x20);

    OLED_WriteCmd(0x8D);
    OLED_WriteCmd(0x14);

    OLED_WriteCmd(0xAF);
}

/* ================================================================
 *  公开接口
 * ================================================================ */

void OLED_Init(void)
{
    HAL_Delay(100);
    i2c_init();
    HAL_Delay(50);

    oled_addr = ADDR_3C;

    if (i2c_probe(oled_addr)) {
    } else if (i2c_probe(ADDR_3D)) {
        oled_addr = ADDR_3D;
    }

    ssd1306_init_seq();

    HAL_Delay(20);
    OLED_Clear();
}

void OLED_Clear(void)
{
    memset(OLED_Buffer, 0x00, sizeof(OLED_Buffer));
    OLED_Refresh();
}

void OLED_ShowString(uint8_t x, uint8_t y, const char *str)
{
    while (*str) {
        if (x + 6 > OLED_WIDTH) {
            x = 0;
            y++;
        }
        if (y >= 8) break;

        uint8_t idx = (uint8_t)*str;
        if (idx < 32 || idx > 127) idx = 32;

        idx -= 32;
        for (uint8_t i = 0; i < 5; i++) {
            OLED_Buffer[y * OLED_WIDTH + x + i] = Font5x7[idx][i];
        }
        OLED_Buffer[y * OLED_WIDTH + x + 5] = 0x00;
        x += 6;
        str++;
    }
}

void OLED_ShowLine(uint8_t line, const char *str)
{
    OLED_ShowString(0, line * 2, str);
}

void OLED_ShowValue(uint8_t line, const char *prefix, int8_t value, const char *suffix)
{
    char buf[17];
    snprintf(buf, sizeof(buf), "%s%d%s", prefix, value, suffix);
    OLED_ShowLine(line, buf);
}
